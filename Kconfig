## boards/KiwiElectronics/nrf52840_quantum_v2/board.yml
```yaml
board:
  name: nrf52840_quantum_v2
  vendor: KiwiElectronics
  socs:
    - name: nrf52840
```

## boards/arm/nrf52840_quantum/Kconfig.board
```kconfig
# Copyright (c) 2022 Nordic Semiconductor ASA
# SPDX-License-Identifier: Apache-2.0

config BOARD_NRF52840_QUANTUM
	select SOC_NRF52840_QIAA

config SPI
  bool "SPI hardware support"
```

## boards/arm/nrf52840_quantum/Kconfig.defconfig
```kconfig
# Copyright (c) 2022 Nordic Semiconductor ASA
# SPDX-License-Identifier: Apache-2.0

if BOARD_NRF52840_QUANTUM

config BOARD
  default "nrf52840_quantum"

config BT_CTLR
  default BT

config SPI
  default y

endif
```

## boards/arm/quantum/Kconfig.defconfig
```kconfig
# Copyright (c) 2021 Nordic Semiconductor ASA
# SPDX-License-Identifier: Apache-2.0

if BOARD_QUANTUM

config BOARD
	default "quantum"

config BT_CTLR
   default BT

endif
```

## boards/arm/test/Kconfig.defconfig
```kconfig
# Copyright (c) 2022 Nordic Semiconductor ASA
# SPDX-License-Identifier: Apache-2.0

if BOARD_TEST

config BOARD
	default "test"

config BT_CTLR
   default BT

endif
```

## build/Kconfig/Kconfig.shield
```kconfig
osource "/Users/ferez/developpement/Quantum/boards/shields/*/Kconfig.shield"
osource "/opt/nordic/ncs/v3.0.2/nrf/boards/shields/*/Kconfig.shield"
```

## build/Kconfig/Kconfig.shield.defconfig
```kconfig
osource "/Users/ferez/developpement/Quantum/boards/shields/*/Kconfig.defconfig"
osource "/opt/nordic/ncs/v3.0.2/nrf/boards/shields/*/Kconfig.defconfig"
```

## build/Kconfig/boards/Kconfig.defconfig
```kconfig
# Load Zephyr board defconfig descriptions.
osource "/Users/ferez/developpement/Quantum/boards/KiwiElectronics/nrf52840_quantum_v2/Kconfig.defconfig"
```

## build/Kconfig/boards/Kconfig.sysbuild
```kconfig
# Load Sysbuild board Kconfig descriptions.
osource "/Users/ferez/developpement/Quantum/boards/KiwiElectronics/nrf52840_quantum_v2/Kconfig.sysbuild"
```

## drivers/Kconfig.ssd1333
```kconfig
# SSD1333 display controller configuration options

# Copyright (c) 2018 Phytec Messtechnik GmbH
# SPDX-License-Identifier: Apache-2.0

menuconfig SSD1333
	bool "SSD1333 display driver"
	depends on SPI || QSPI || I2C
	help
	  Enable driver for SSD1333 display driver.

if SSD1333

config SSD1333_DEFAULT_CONTRAST
	int "SSD1333 default contrast"
	default 128
	range 0 255
	help
	  SSD1333 default contrast.

choice SSD1333_CONTROLLER_TYPE
	prompt "Display controller type"
	default SSD1333_DEFAULT
	help
	  Specify the type of the controller.

config SSD1333_DEFAULT
	bool "Default SSD1333 controller"

endchoice

config SSD1333_REVERSE_MODE
	bool "SSD1333 reverse mode"
	help
	  SSD1333 reverse video mode.

endif # SSD1333
```

## drivers/dts/bindings/display/solomon,ssd1333.yaml
```yaml
# Copyright (c) 2020, Marco Peter
# SPDX-License-Identifier: Apache-2.0

description: SSD1333 160x128 dot-matrix display controller on SPI bus

compatible: "solomon,ssd1333"

include: [spi-device.yaml, display-controller.yaml]

properties:
    data-ctrl-gpios:
      type: phandle-array
      required: true
      description: D/C# pin.

    spi-max-frequency:
      type: int
      required: true
      description: Maximum clock frequency of device's SPI interface in Hz

    reset-gpios:
      type: phandle-array
      required: false
      description: RESET pin.

    label:
      required: true
```

## sample.yaml
```yaml
sample:
  description: Quantum program based on Zephyr OS
  name: Quantum
common:
    tags: introduction
    integration_platforms:
      - native_posix
    harness: console
    harness_config:
      type: one_line
      regex:
        - "Hello World! (.*)"
tests:
  sample.basic.helloworld:
    tags: introduction
```
